## main/Kconfig.projbuild
```kconfig
menu "Gravity Configuration"

    config FLIPPER
        bool "Condense output for Flipper Zero screen size"
        default n
        help
            As a console application, Gravity has been developed around a traditional
            80x25 character terminal. Flipper Zero has a 20x5 character screen; this
            option condenses and reduces output from Gravity to be more amenable
            to use on Flipper Zero.

    config DEFAULT_HOP_MILLIS
        int "Default dwell time for most features when channel hopping (milliseconds)"
        default 500
        help
            This specifies the default length of time Gravity should remain on a
            wireless channel before progressing to the next channel when
            channel hopping is enabled, for all features except Mana and
            handshake capture (not yet implemented).

    config DEFAULT_MANA_HOP_MILLIS
        int "Default dwell time for larger features when channel hopping (milliseconds)"
        default 5000
        help
            The specifies the default length of time Gravity should remain on a
            wireless channel before progressing to the next channel when channel
            hopping is enabled, for the Mana attack and (when implemented)
            handshake capture.
    
    config BLE_SCAN_SECONDS
        int "Number of seconds for a single cycle of BLE scanning"
        default 10
        help
            This specifies the duration of BLE scanning. When this duration has passed
            Gravity will display a status message and restart scanning continually until
            scanning is deactivated; apart from a negligible performance impact this
            setting is mostly concerned with how frequently you would like a status update.
    
    config BT_SCAN_DURATION
        int "Duration of a Bluetooth Classic scan cycle"
        default 16
        help
            This specifies the duration of Bluetooth Classic Discovery, in 1.28-second units.
            When this duration has passed Gravity will display a status message and restart
            scanning continually until scanning is deactivated; apart from a negligible
            performance impact this setting is mostly concerned with how frequentnly you would
            like a status update.
            Developer's recommendation: 0x10 (16).

    config BLE_PURGE_MIN_AGE
        int "Do not automatically purge BLE devices seen within the specified number of seconds"
        default 30
        help
            BLE devices are pervasive and it is far from difficult to exhaust ESP32's memory by
            performing a BLE scan in a crowded area (a rough estimate has around 150 BLE devices
            filling ESP32's 4MB). To avoid the disruption this causes Gravity provides several
            approaches to automatically purge the least-interesting BLE devices; one of these is
            based on the time since the device was last seen.
            If enabled, age-based BLE purging will not remove any BLE devices seen within the
            specified number of seconds.

    config BLE_PURGE_MAX_RSSI
        int "Do not automatically purge BLE devices with an RSSI greater than this value"
        default -70
        help
            BLE devices are pervasive and it is far from difficult to exhaust ESP32's memory by
            performing a BLE scan in a crowded area (a rough estimate has around 150 BLE devices
            filling ESP32's 4MB). To avoid the disruption this causes Gravity provides several
            approaches to automatically purge the least-interesting BLE devices; one of these is
            based on the Received Signal Strength Indicator, or RSSI, of discovered devices.
            If enabled, RSSI-based BLE purging will not remove any BLE devices with an RSSI greater
            than the specified number. Remember that RSSI is a negative number; numbers closer to
            zero are better.

    config DEFAULT_ATTACK_MILLIS
        int "Default time between packets during an attack (milliseconds)"
        default 5
        help
            To avoid causing too much traffic/chaos on a network during attacks,
            the rate at which deauth packets are sent can be throttled using this
            setting. Gravity will pause the specified number of milliseconds in between
            each packet during an attack.

    config MALFORMED_FROM
        int "Number of (valid) characters in an SSID being subject to Malformed Fuzzing"
        default 16
        help
            The Malformed Fuzz attack starts with a wireless packet containing a regular
            SSID. This SSID is then manipulated in various ways to see how the wireless
            router responds. This option specifies the length of this initial SSID. For
            reference, the maximum length of an SSID is 32 bytes.

    config DEFAULT_SCRAMBLE_WORDS
        bool "Use random characters, not random words, when generating SSIDs"
        default n
        help
            beacon RANDOM, beacon INFINITE and all FUZZ commands include the generation
            of random SSIDs. By default these SSIDs use a sequence of words, drawn from
            words.h. Select this option to use random characters rather than random words.
            Select this if you have memory issues; the 1000-word dictionary will not be
            loaded to ESP32.

    config DISPLAY_FRIENDLY_AGE
        bool "Display age in a friendly, rather than specific, way"
        default y
        help
            The setting determines whether, when displaying the age of discovered devices,
            Gravity should use a 'user-friendly' format, for example 'under a minute ago',
            or specify the exact number of seconds that have elapsed. Default is friendly.

    config MIN_ATTACK_MILLIS
        int "Minimum time between attack packets for sensitivy processes (milliseconds)."
        default 50
        help
            The beacon attack sends beacon frame too quickly to be observed by Wireshark. I'm
            unclear whether the culprit is the sender or receiver, but the situation improves
            significants by introducing a small delay. A single tick works well enough; this
            option specifies the minimum number of milliseconds for such attacks.
            This option applies to the BEACON command, excluding the infinite attack mode.

    config FLIPPER_SEPARATOR
        string "Character used to separate the selection of multiple scan results on a Flipper Zero."
        default "~"
        help
            Currently, the Flipper Zero keyboard lacks a space button, making it slow and clumsy
            to select multiple stations or access points from scan results. The separator specified
            here can be used instead of a space to specify multiple scan results in a single
            command, e.g. select STA 1~2~6

    config DEBUG
        bool "Enable debugging output"
        default y
        help
            This option displays additional logging information to aid in the identification
            and resolution of issues.
        
    config DEBUG_VERBOSE
        bool "Enable verbose debugging output"
        default n
        help
            This option displays an excessive amount of additional logging information.

    config SSID_LEN_MIN
        int "Minimum length for generated SSIDs"
        default 8
        help
            This value specifies the minimum length of randomly-generated SSIDs.

    config SSID_LEN_MAX
        int "Maximum length for generated SSIDs"
        default 32
        help
            This value specifies the maximum length of randomly-generated SSIDs.

    config DEFAULT_SSID_COUNT
        int "Default number of generated SSIDs"
        default 20
        help
            This values specifies the default number of SSIDs that are generated by BEACON RANDOM.

    config CONSOLE_STORE_HISTORY
        bool "Store command history in flash"
        default y
        help
            Linenoise line editing library provides functions to save and load
            command history. If this option is enabled, initalizes a FAT filesystem
            and uses it to store command history.

    config CONSOLE_MAX_COMMAND_LINE_LENGTH
        int "Maximum command line length"
        default 1024
        help
            This value marks the maximum length of a single command line. Once it is
            reached, no more characters will be accepted by the console.

endmenu
```
